## base_external/package/ldd/Config.in
```kconfig
config BR2_PACKAGE_LDD
	bool "ldd"
	depends on BR2_LINUX_KERNEL
	help
	   include support for building and installing the misc-modules and scull
 	   components on your qemu target based on your fork of the ldd3 repository
```
